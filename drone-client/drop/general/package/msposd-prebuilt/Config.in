## drone-client/drop/general/package/msposd-prebuilt/Config.in
```kconfig
config BR2_PACKAGE_MSPOSD_PREBUILT
	bool "msposd (prebuilt SigmaStar binary)"
	help
	  OpenIPC msposd — MAVLink/MSP OSD overlay daemon for Majestic.

	  Pulls the latest prebuilt msposd_star6e binary and INAV fonts from
	  https://github.com/OpenIPC/msposd/releases/download/latest/

	  Provides /usr/bin/msposd, /usr/share/fonts/font.png and font_hd.png,
	  /etc/init.d/S96msposd, and /etc/msposd.conf.
```

## drone-client/drop/general/package/skypulse/Config.in
```kconfig
config BR2_PACKAGE_SKYPULSE
	bool "skypulse-drone"
	help
	  SkyPulse drone client — CRSF/UART bridge between ArduPilot FC and
	  the GCS over WireGuard, with failsafe FSM (NORMAL → STABILIZE →
	  FAILSAFE → LOCAL/ELRS).

	  https://github.com/lvivdronehub/piper
```
